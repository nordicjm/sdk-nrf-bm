## boards/nordic/bm_nrf54l15dk/Kconfig.defconfig
```kconfig
#
# Copyright (c) 2025 Nordic Semiconductor
#
# SPDX-License-Identifier: LicenseRef-Nordic-5-Clause
#

config ROM_START_OFFSET
	default 0x80 if BOOTLOADER_MCUBOOT
```
